## boards/shields/tempest/Kconfig.shield
```kconfig
# Copyright (c) 2020 Pete Johanson
# SPDX-License-Identifier: MIT

config SHIELD_TEMPEST_LEFT
    def_bool $(shields_list_contains,tempest_left)

config SHIELD_TEMPEST_RIGHT
    def_bool $(shields_list_contains,tempest_right)
```

## config/west.yml
```yaml
manifest:
  remotes:
    - name: zmkfirmware
      url-base: https://github.com/zmkfirmware
    # Additional modules containing boards/shields/custom code can be listed here as well
    # See https://docs.zephyrproject.org/3.2.0/develop/west/manifest.html#projects
    - name: m165437 # nice gem view:
      url-base: https://github.com/M165437
  projects:
    - name: zmk
      remote: zmkfirmware
      revision: main
      import: app/west.yml
    - name: nice-view-gem # nice gem view:
      remote: m165437
      revision: main
  self:
    path: config
```
